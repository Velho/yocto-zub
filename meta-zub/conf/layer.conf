## meta-zub/conf/layer.conf
```bitbake
# We have a conf and classes directory, add to BBPATH
BBPATH .= ":${LAYERDIR}"

# We have recipes-* directories, add to BBFILES
BBFILES += "${LAYERDIR}/recipes-*/*/*.bb \
            ${LAYERDIR}/recipes-*/*/*.bbappend"

BBFILE_COLLECTIONS += "meta-zub"
BBFILE_PATTERN_meta-zub = "^${LAYERDIR}/"
BBFILE_PRIORITY_meta-zub = "6"

LAYERDEPENDS_meta-zub = "core"
LAYERSERIES_COMPAT_meta-zub = "kirkstone"
```
